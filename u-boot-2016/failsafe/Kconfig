## u-boot-2016/failsafe/Kconfig
```kconfig
config FAILSAFE_UBOOT_PRIMARY_ONLY
    bool "Web U-Boot update writes only 0:APPSBL"
    default n
    help
      Leave 0:APPSBL_1 untouched when the web page installs a U-Boot.
      Use this on boards whose stock BOOTCONFIG always selects the primary
      APPSBL and whose stock 0:APPSBL_1 is empty.

config FAILSAFE_BOARD_ID
    string "Board id the web U-Boot update must find in the image"
    depends on !H3C_IPQ5018_COMMON
    default "ipq5018_cmcc_mr3000d_ci" if TARGET_IPQ5018_CMCC_MR3000D_CI
    default "ipq5018_cmcc_pz_l8" if TARGET_IPQ5018_CMCC_PZ_L8
    default "ipq5018_cmcc_rax3000q" if TARGET_IPQ5018_CMCC_RAX3000Q
    default "ipq5018_cucc_vs010" if TARGET_IPQ5018_CUCC_VS010
    default "ipq5018_jdcloud_ax3000" if TARGET_IPQ5018_JDCLOUD_AX3000
    default "ipq5018_lingyan_lyw_30m" if TARGET_IPQ5018_LINGYAN_LYW_30M
    default "ipq5018_tcl_t30_pro" if TARGET_IPQ5018_TCL_T30_PRO
    default "ipq5018_hw3000b1" if TARGET_IPQ5018_HW3000B1
    default "ipq5018_xiaomi_cr8806" if TARGET_IPQ5018_XIAOMI_CR8806
    default "ipq5018_ruijie_rg_ma3063" if TARGET_IPQ5018_RUIJIE_RG_MA3063
    default "ipq5018_ruijie_rg_ma3063_v3" if TARGET_IPQ5018_RUIJIE_RG_MA3063_V3
    default ""
    help
      Every non-H3C build carries "IPQ50XX-UBOOT-BOARD=<id>" exactly once
      (<id> = the defconfig name). The web U-Boot update installs an ELF
      only when it holds exactly one mark naming this board. Empty: the
      web U-Boot update refuses every image (install over TTL instead).

config FAILSAFE_MAC_MANAGEMENT
    bool "Enable Web Failsafe MAC management"
    default n

choice
    prompt "MAC Address Type"
    default MAC_TYPE_RAW_HEX
    depends on FAILSAFE_MAC_MANAGEMENT

config MAC_TYPE_RAW_HEX
    bool "Raw Hex"

config MAC_TYPE_ASCII
    bool "ASCII"

endchoice

config MAC_PART_NAME
    string "MAC address partition name"
    default "0:ART"
    depends on FAILSAFE_MAC_MANAGEMENT

config MAC_OFFSET_IN_PART
    hex "MAC address offset in partition"
    depends on MAC_TYPE_RAW_HEX

config MAC_LABEL
    string "MAC ASCII label string"
    depends on MAC_TYPE_ASCII

config MAC_COUNT
    int "Number of MAC addresses"
    depends on FAILSAFE_MAC_MANAGEMENT
```
